VERSION ""

NS_ :

BS_:

BU_:
VAL_TABLE_ KL30C_Status 1 "KL30C Power absent" 0 "KL30C Power present" ;

BO_ 544 PostContactorVoltage: 8 Vector__XXX
 SG_ Battery_Voltage : 0|24@1+ (0.001,0) [0|16777.215] "" Vector__XXX

BO_ 1296 Status: 8 Vector__XXX
 SG_ KL30C_Status : 28|1@1- (1,0) [0|0] "" Vector__XXX

BO_ 512 Current: 8 Vector__XXX
 SG_ Battery_Current : 0|16@1+ (1,0) [-2147483648|2147483647] "" Vector__XXX

BO_ 529 PackVoltage: 8 Vector__XXX
 SG_ Battery_Voltage : 0|24@1+ (0.001,0) [0|16777.215] "" Vector__XXX

BA_DEF_  "BusType" STRING ;
BA_DEF_DEF_  "BusType" "CAN";
VAL_ 1296 KL30C_Status 1 "KL30C Power absent" 0 "KL30C Power present" ;
